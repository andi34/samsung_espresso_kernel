## arch/arm/mach-omap2/Kconfig.mid
```kconfig
config MP3_LP_MODE
	bool "mp3 LP"
	default n
	help
	  to reduce mp3 current consumption, turn down cpu1 and limit
	  cpu frequency when the device is in earlysuspend mode MP3
	  playback.
```
